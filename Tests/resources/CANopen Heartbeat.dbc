VERSION ""

NS_ :

BS_ :

BU_ :

BO_ 1794 Data: 8 Vector__XXX
  SG_ New_signal_1 : 0|8@1+ (1,0) [0|1000] "" Vector__XXX

BO_ 1793 Heartbeat: 8 Vector__XXX
  SG_ ALIVE : 0|32@1+ (1,0) [0|1000] "" Vector__XXX

BA_DEF_ "DBName" STRING;
BA_DEF_ "BusType" STRING;
BA_DEF_ BO_ "VFrameFormat" ENUM "StandardCAN","ExtendedCAN","reserved","J1939PG","reserved","reserved","reserved","reserved","reserved","reserved","reserved","reserved","reserved","reserved","StandardCAN_FD","ExtendedCAN_FD";
BA_DEF_ BO_ "GenMsgSendType" ENUM "Cyclic","Event","CyclicIfActive","SpontanWithDelay","CyclicAndSpontan","CyclicAndSpontanWithDelay";
BA_DEF_ BO_ "GenMsgDelayTime" INT 0 0;
BA_DEF_DEF_ "DBName" "Cluster";
BA_DEF_DEF_ "BusType" "CAN";
BA_DEF_DEF_ "VFrameFormat" "StandardCAN";
BA_DEF_DEF_ "GenMsgSendType" "Cyclic";
BA_DEF_DEF_ "GenMsgDelayTime" 0;
BA_ "GenMsgSendType" BO_ 1794 3;
BA_ "GenMsgDelayTime" BO_ 1794 100;
BA_ "GenMsgSendType" BO_ 1793 3;
BA_ "GenMsgDelayTime" BO_ 1793 100;
